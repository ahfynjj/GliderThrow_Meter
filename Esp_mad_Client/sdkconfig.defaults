## Esp_mad_Client/sdkconfig.defaults
```kconfig
## Default configuration for ESP32-C3 target
CONFIG_IDF_TARGET="esp32c3"
CONFIG_IDF_TARGET_ESP32C3=y
CONFIG_IDF_TARGET_ARCH="riscv"
CONFIG_IDF_TARGET_ARCH_RISCV=y

# If you regenerate sdkconfig via `idf.py set-target esp32c3`, these defaults will be used as a base.
```

## Esp_mad_Server/sdkconfig.defaults
```kconfig
## Default configuration for ESP32-C3 target
CONFIG_IDF_TARGET="esp32c3"
CONFIG_IDF_TARGET_ESP32C3=y
CONFIG_IDF_TARGET_ARCH="riscv"
CONFIG_IDF_TARGET_ARCH_RISCV=y

# If you regenerate sdkconfig via `idf.py set-target esp32c3`, these defaults will be used as a base.

# Use the larger single-app partition table so the firmware fits comfortably.
# CONFIG_PARTITION_TABLE_SINGLE_APP is not set
CONFIG_PARTITION_TABLE_SINGLE_APP_LARGE=y
# CONFIG_PARTITION_TABLE_TWO_OTA is not set
# CONFIG_PARTITION_TABLE_TWO_OTA_LARGE is not set
# CONFIG_PARTITION_TABLE_CUSTOM is not set
CONFIG_PARTITION_TABLE_CUSTOM_FILENAME="partitions.csv"
CONFIG_PARTITION_TABLE_FILENAME="partitions_singleapp_large.csv"
CONFIG_PARTITION_TABLE_OFFSET=0x8000
CONFIG_PARTITION_TABLE_MD5=y
```
